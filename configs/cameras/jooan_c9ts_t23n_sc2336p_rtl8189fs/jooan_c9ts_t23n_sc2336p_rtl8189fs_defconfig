## configs/cameras/jooan_c9ts_t23n_sc2336p_rtl8189fs/jooan_c9ts_t23n_sc2336p_rtl8189fs_defconfig
```kconfig
# NAME: Jooan C9TS-U (T23N, SC2336P, ATBM6132U)
# FRAG: soc-xburst1 core ssl
BR2_INGENIC_SOC_MODEL="t23n"
BR2_ISP_CLK_300MHZ=y
BR2_PACKAGE_THINGINO_KOPT_MMC0=y
BR2_PACKAGE_THINGINO_KOPT_MMC0_PB_4BIT=y
BR2_PACKAGE_WIFI=y
BR2_PACKAGE_RTL8189FS=y
BR2_PACKAGE_RTL8189FS_CUSTOM_REPO=y
BR2_PACKAGE_RTL8189FS_CUSTOM_REPO_URL="https://github.com/jwrdegoede/rtl8189ES_linux"
BR2_PACKAGE_RTL8189FS_CUSTOM_REPO_VERSION="master"
BR2_PACKAGE_WIFI_RTL8189FS=y
THINGINO_WIRELESS_DRIVER="rtl8189fs"
BR2_SENSOR_1_NAME="sc2336p"
BR2_THINGINO_AUDIO=y
BR2_THINGINO_AUDIO_GPIO=63
BR2_THINGINO_AUDIO_GPIO_LOW=y
BR2_THINGINO_BUTTON=y
BR2_THINGINO_MOTORS=y
BR2_THINGINO_SDCARD=y
FLASH_SIZE_MB=8
BR2_PRIMARY_SITE="https://buildroot.net"
# BR2_PACKAGE_WIREGUARD_LINUX_COMPAT is not set
BR2_PACKAGE_WIREGUARD_LINUX_COMPAT_NONE=y
THINGINO_WIREGUARD=n
```
